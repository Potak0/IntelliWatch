/* Variable definitions for ESP32ULP linker
 * This file is generated automatically by esp32ulp_mapgen.py utility.
 */

PROVIDE ( ulp___stack_top = 0x50000200 );
PROVIDE ( ulp_irq_vector = 0x50000010 );
PROVIDE ( ulp_main = 0x5000002a );
PROVIDE ( ulp_reset_vector = 0x50000000 );
PROVIDE ( ulp_ulp_riscv_rescue_from_monitor = 0x50000062 );
PROVIDE ( ulp_ulp_riscv_shutdown = 0x50000082 );
PROVIDE ( ulp_ulp_riscv_wakeup_main_processor = 0x50000076 );
